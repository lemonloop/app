## CMakeLists.txt
```
cmake_minimum_required(VERSION 3.20.0)
find_package(Zephyr REQUIRED HINTS $ENV{ZEPHYR_BASE})

project(app)

target_sources(app PRIVATE src/main.c
                    src/functionalities.c
                    src/functionalities.h
                    src/project.h
                    src/u_error_common.h
                    src/u_ubx_protocol.c
                    src/u_ubx_protocol.h)

set(BOARD_ROOT ${CMAKE_CURRENT_SOURCE_DIR}/.)
list(APPEND BOARD_ROOT ${CMAKE_CURRENT_SOURCE_DIR}/boards>)
# list(APPEND ZEPHYR_EXTRA_MODULES ${CMAKE_CURRENT_SOURCE_DIR}/drivers/ubx )
```

## prj.conf
```kconfig
# Logging
CONFIG_LOG=y
CONFIG_LOG_MODE_IMMEDIATE=y
CONFIG_CONSOLE=y
#CONFIG_UART_ASYNC_API=y
CONFIG_UART_INTERRUPT_DRIVEN=y
CONFIG_USE_SEGGER_RTT=y
CONFIG_LOG_BACKEND_RTT=y
# CONFIG_UART_CONSOLE=y
# CONFIG_LOG_BACKEND_UART=y
CONFIG_SEGGER_RTT_BUFFER_SIZE_UP=4096
CONFIG_MAIN_STACK_SIZE=4096

CONFIG_SPI=y
CONFIG_SENSOR=y
CONFIG_ISM330DHCX=y
CONFIG_LSM303DLHC_MAGN=y

# ublox gnss module 
# CONFIG_UBXCOMMANDS=y

# LEDs
CONFIG_REGULATOR=y
CONFIG_LED=y
CONFIG_I2C=y
CONFIG_NPM1300_CHARGER=y

# LoRa
CONFIG_LORA=y
#CONFIG_LORA_SHELL=y
CONFIG_LORA_LOG_LEVEL_DBG=n
CONFIG_HAS_SEMTECH_RADIO_DRIVERS=y
CONFIG_LORA_SX126X=y

#CONFIG_NFCT_PINS_AS_GPIOS=y # disable NFC (inorder to us pins 0.9 and 0.10 as GPIO)
```

## src/main.c
```c
#include "project.h"
#include "functionalities.h"

LOG_MODULE_REGISTER(main,LOG_LEVEL_DBG);

#define ZEPHYR_USER_NODE DT_PATH(zephyr_user)

// device pointers
//const struct device *uart = DEVICE_DT_GET(DT_NODELABEL(uart0));
const struct gpio_dt_spec uart_ctrl = GPIO_DT_SPEC_GET(ZEPHYR_USER_NODE, uartctrl_gpios);
const struct gpio_dt_spec en_led = GPIO_DT_SPEC_GET(ZEPHYR_USER_NODE,en_ledring_gpios);

// // uart
// static uint8_t rx_buf[128] = {0};
// static uint8_t tx_buf[64] = {"hello"};

// static void uart_cb(const struct device *dev, struct uart_event *evt, void *user_data)
// {
// 	switch (evt->type) {
		
// 	case UART_TX_DONE:
//                 LOG_DBG("uart send buffer");
//                 break;
        
//         case UART_RX_RDY:
// 		// do something
//                 int size = evt->data.rx.len;
//                 int offset = evt->data.rx.offset;
//                 for (int i=0; i<size; i++){
//                         rx_buf[i] = evt->data.rx.buf[offset + i];
//                 }
// 		break;
		
// 	case UART_RX_DISABLED:
// 		uart_rx_enable(dev, rx_buf, sizeof(rx_buf), 100);
// 		break;
		
// 	default:
// 		break;
// 	}
// }

int main(void)
{
        struct gps_data gps;
#if MASTER
        struct gps_data slave_gps;
        uint64_t gps_origin;
        int16_t slave_rssi;
        int8_t slave_snr;
#endif
        // if(!device_is_ready(&uart_ctrl)){
        //         LOG_ERR("uart control pin not ready");
        //         return 1;
        // }
        
        int err = gpio_pin_configure_dt(&uart_ctrl, GPIO_OUTPUT_HIGH);
        
        if (!device_is_ready(gps_uart)){
                LOG_ERR("uart not ready");
        }

        k_msleep(1000);
        err = npm1300_init();
        //activate the led drivers
        err = gpio_pin_configure_dt(&en_led,GPIO_OUTPUT_HIGH);
        err = lp5012_init();
        
        // asynch
        // err = uart_callback_set(uart, gps_serial_cb, &gps);
	// if (err) {
	// 	LOG_ERR("uart callback not set");
        //         //return err;
	// }

        // uart_rx_enable(uart, rx_buf, sizeof(rx_buf), 100);


        // interupt driven
	uart_irq_callback_user_data_set(gps_uart, gps_serial_cb, &gps);
	uart_irq_rx_enable(gps_uart);
        k_msleep(100);
        gps_init();
        gps_reset_data(&gps);
        gps_poll(&gps);

        //lora
        k_msleep(500);
        lora_init();
        k_msleep(500);
        

        while(1){
                // err = uart_tx(uart, tx_buf, sizeof(tx_buf), SYS_FOREVER_US);
                // if(err){
                //         LOG_ERR("uart could not send, err = %d",err);
                //         return err;
                // }

                // gps_poll(&gps);
                // k_sleep(K_MSEC(1000));
                // gps_reset_data(&gps);
                // k_msleep(100);{
#if MASTER
                lora_receive_data(&slave_gps,&gps_origin,&slave_rssi,&slave_snr);
                k_msleep(100);
#else
                lora_send_data(&gps);
                k_msleep(1000);
#endif

        }

        // int err;

        // err = spi_is_ready_dt(&ism330_spispec);
        // if(!err){
        //         LOG_ERR("Error: SPI device is not ready, err:%d",err);
        //         return 0;
        // }

        // err = spi_is_ready_dt(&lsm303_spispec);
        // if(!err){
        //         LOG_ERR("Error: SPI device is not ready, err:%d",err);
        //         return 0;
        // }

        // //ism_init();
        // k_msleep(100);
        // lsm_init();
        // //k_msleep(100);
        // //struct ism_data ismdata;
        // struct lsm_data lsmdata;
        // int i = 10;

        // while(i>0){
        //         // err = ism_read_outputs(ismdata);
        //         // if(err != 0){
        //         //         LOG_ERR("Error: reading sensor data from ISM330 failed, err: %d",err);
        //         //         return 0;
        //         // }
        //         // k_msleep(100);
        //         err = lsm_read_outputs(lsmdata);
        //         if(err != 0){
        //                 LOG_ERR("Error: reading sensor data from LSM303 failed, err: %d",err);
        //                 return 0;
        //         }
        //         k_msleep(100);
        //         i--;
        // }
        
        return 0;
}
```

## src/functionalities.c
```c
#include "functionalities.h"

LOG_MODULE_REGISTER(functionalities,LOG_LEVEL_DBG);

/************ sensor: LSM303AHTR ************/

/*
 * lsm_read_reg
 * -------------
 * read values from register of lsm303ahtr
 * 
 * reg: register address
 * data: pointer to place to store the read data
 * size: amount of bits to be read
 * 
 * returns: 0 / error code of spi_transceive_dt()
 */
static int lsm_read_reg(uint8_t reg, uint8_t *data, uint8_t size){
        uint8_t tx_buffer = reg;
	struct spi_buf tx_spi_buf			= {.buf = (void *)&tx_buffer, .len = 1};
	struct spi_buf_set tx_spi_buf_set 	= {.buffers = &tx_spi_buf, .count = 1};
	struct spi_buf rx_spi_bufs 			= {.buf = data, .len = size};
	struct spi_buf_set rx_spi_buf_set	= {.buffers = &rx_spi_bufs, .count = 1};

	int err = spi_transceive_dt(&lsm303_spispec, &tx_spi_buf_set, &rx_spi_buf_set);
	if (err < 0) {
		LOG_ERR("spi_transceive_dt() failed, err: %d", err);
		return err;
	}
	return 0;
}

static int lsm_write_reg(uint8_t reg, uint8_t value){
	uint8_t tx_buf[] = {(reg & 0x7F), value};	
	struct spi_buf 		tx_spi_buf 		= {.buf = tx_buf, .len = sizeof(tx_buf)};
	struct spi_buf_set 	tx_spi_buf_set	= {.buffers = &tx_spi_buf, .count = 1};

	int err = spi_write_dt(&lsm303_spispec, &tx_spi_buf_set);
	if (err < 0) {
		LOG_ERR("spi_write_dt() failed, err %d", err);
		return err;
	}
	return 0;
}

void lsm_init(void){
    uint8_t regaddr;
    int err;

    LOG_INF("-------------------------------------------------------------");
    LOG_INF("lsm_init: initializing sensor by writing to the config registers.");

    // config register CTRL1_A
    regaddr = 0x20;
    err = lsm_write_reg(regaddr,CTRL1_A);
    if(err != 0){
        LOG_ERR("could not write to config register CTRL1_A");
    }
    k_msleep(DELAY_PARAM);

    // config register CTRL2_A
    regaddr = 0x21;
    err = lsm_write_reg(regaddr,CTRL2_A);
    if(err != 0){
        LOG_ERR("could not write to config register CTRL2_A");
    }
    k_msleep(DELAY_PARAM);

    // config register CFG_REG_A_M
    regaddr = 0x60;
    err = lsm_write_reg(regaddr,CFG_REG_A_M);
    if(err != 0){
        LOG_ERR("could not write to config register CFG_REG_A_M");
    }
    k_msleep(DELAY_PARAM);

    // config register CFG_REG_B_M
    regaddr = 0x61;
    err = lsm_write_reg(regaddr,CFG_REG_B_M);
    if(err != 0){
        LOG_ERR("could not write to config register CFG_REG_B_M");
    }
    k_msleep(DELAY_PARAM);

    // config register CFG_REG_C_M
    regaddr = 0x62;
    err = lsm_write_reg(regaddr,CFG_REG_C_M);
    if(err != 0){
        LOG_ERR("could not write to config register CFG_REG_C_M");
    }
    k_msleep(DELAY_PARAM);
    LOG_INF("-------------------------------------------------------------");

    return;
}

int lsm_read_outputs(struct lsm_data lsmdata){
	int err;

    int16_t acc_x=0,acc_y=0,acc_z=0,mag_x=0,mag_y=0,mag_z=0;
    int8_t temp=0;

    // registers to read
    uint8_t regs_buffer[14] = {0x26, 0x28, 0x29, 0x2A, 0x2B, 0x2C, \
        0x2D, 0x68, 0x69, 0x6A, 0x6B, 0x6C, 0x6D}; // 0xFF dummy
    
    uint8_t readbuf[sizeof(regs_buffer)];

	struct spi_buf 		tx_spi_buf 			= {.buf = (void *)&regs_buffer, .len = sizeof(regs_buffer)};
	struct spi_buf_set 	tx_spi_buf_set		= {.buffers = &tx_spi_buf, .count = 1};
	struct spi_buf 		rx_spi_bufs			= {.buf = readbuf, .len = sizeof(regs_buffer)};
	struct spi_buf_set 	rx_spi_buf_set	= {.buffers = &rx_spi_bufs, .count = 1};

	err = spi_transceive_dt(&lsm303_spispec, &tx_spi_buf_set, &rx_spi_buf_set);
	if (err < 0) {
		LOG_ERR("spi_transceive_dt() failed, err: %d", err);
		return err;
	}

    temp = readbuf[1];

    acc_x = (readbuf[2] & 0x0F) | (readbuf[3] << 8);
    acc_y = (readbuf[4] & 0x0F) | (readbuf[5] << 8);
    acc_z = (readbuf[6] & 0x0F) | (readbuf[7] << 8);

    mag_x = (readbuf[8] & 0x0F) | (readbuf[9] << 8);
    mag_y = (readbuf[10] & 0x0F) | (readbuf[11] << 8);
    mag_z = (readbuf[12] & 0x0F) | (readbuf[13] << 8);

    lsmdata.out_t_a = temp;
    lsmdata.out_x_a = acc_x;
    lsmdata.out_y_a = acc_y;
    lsmdata.out_z_a = acc_z;
    lsmdata.outx_m = mag_x;
    lsmdata.outy_m = mag_y;
    lsmdata.outz_m = mag_z;

    LOG_INF("\tTemperature: \t %d", temp);
    LOG_INF("\tAccelerometer: \t X:%d, \t Y:%d, \t Z:%d",acc_x,acc_y,acc_z);
    LOG_INF("\tMegnetometer: \t X:%d, \t Y:%d, \t Z:%d",mag_x,mag_y,mag_z);

    return 0;
}


/************ sensor: ISM330DHCXTR ************/

/*
 * ism_read_reg
 * ---------------------
 * read values from register of ism330dhcx
 * 
 * reg: register address
 * data: pointer to place to store the read data
 * size: amount of bits to be read
 * 
 * returns: 0 | error code for transceive dt
 */
static int ism_read_reg(uint8_t reg, uint8_t *data, uint8_t size){
        uint8_t tx_buffer = reg;
	struct spi_buf tx_spi_buf			= {.buf = (void *)&tx_buffer, .len = 1};
	struct spi_buf_set tx_spi_buf_set 	= {.buffers = &tx_spi_buf, .count = 1};
	struct spi_buf rx_spi_bufs 			= {.buf = data, .len = size};
	struct spi_buf_set rx_spi_buf_set	= {.buffers = &rx_spi_bufs, .count = 1};

	int err = spi_transceive_dt(&ism330_spispec, &tx_spi_buf_set, &rx_spi_buf_set);
	if (err < 0) {
		LOG_ERR("spi_transceive_dt() failed, err: %d", err);
		return err;
	}
	return 0;
}

static int ism_write_reg(uint8_t reg, uint8_t value){
	uint8_t tx_buf[] = {(reg & 0x7F), value};	
	struct spi_buf 		tx_spi_buf 		= {.buf = tx_buf, .len = sizeof(tx_buf)};
	struct spi_buf_set 	tx_spi_buf_set	= {.buffers = &tx_spi_buf, .count = 1};

	int err = spi_write_dt(&ism330_spispec, &tx_spi_buf_set);
	if (err < 0) {
		LOG_ERR("spi_write_dt() failed, err %d", err);
		return err;
	}
	return 0;
}

void ism_init(void){
    uint8_t regaddr;
    int err;

    LOG_INF("-------------------------------------------------------------");
    LOG_INF("ism_init: initializing sensor by writing to the config registers.");

    // config register CTRL1_XL
    regaddr = 0x10;
    err = ism_write_reg(regaddr,CTRL1_XL);
    if(err != 0){
        LOG_ERR("could not write to config register CTRL1_XL");
    }
    k_msleep(DELAY_PARAM_ISM);

    // config register CTRL2_G
    regaddr = 0x11;
    err = ism_write_reg(regaddr,CTRL2_G);
    if(err != 0){
        LOG_ERR("could not write to config register CTRL2_G");
    }
    k_msleep(DELAY_PARAM_ISM);
    LOG_INF("-------------------------------------------------------------");

    return;
}

int ism_read_outputs(struct ism_data ismdata){
	int err;

    int16_t acc_x=0,acc_y=0,acc_z=0,gyr_x=0,gyr_y=0,gyr_z=0,temp=0;

    // registers to read
    uint8_t regs_buffer[15] = {0x20, 0x21, 0x22, 0x23, 0x24, 0x25, \
        0x26, 0x27, 0x28, 0x29, 0x2A, 0x2B, 0x2C, 0x2D}; // 0xFF dummy
    
    uint8_t readbuf[sizeof(regs_buffer)];

	struct spi_buf 		tx_spi_buf 			= {.buf = (void *)&regs_buffer, .len = sizeof(regs_buffer)};
	struct spi_buf_set 	tx_spi_buf_set		= {.buffers = &tx_spi_buf, .count = 1};
	struct spi_buf 		rx_spi_bufs			= {.buf = readbuf, .len = sizeof(regs_buffer)};
	struct spi_buf_set 	rx_spi_buf_set	= {.buffers = &rx_spi_bufs, .count = 1};

	err = spi_transceive_dt(&ism330_spispec, &tx_spi_buf_set, &rx_spi_buf_set);
	if (err < 0) {
		LOG_ERR("spi_transceive_dt() failed, err: %d", err);
		return err;
	}

    // readbuf[0] is chunk
    temp = (readbuf[1] & 0x0F) | (readbuf[2] << 8);

    acc_x = (readbuf[3] & 0x0F) | (readbuf[4] << 8);
    acc_y = (readbuf[5] & 0x0F) | (readbuf[6] << 8);
    acc_z = (readbuf[7] & 0x0F) | (readbuf[8] << 8);

    gyr_x = (readbuf[9] & 0x0F) | (readbuf[10] << 8);
    gyr_y = (readbuf[11] & 0x0F) | (readbuf[13] << 8);
    gyr_z = (readbuf[13] & 0x0F) | (readbuf[14] << 8);

    ismdata.out_temp = temp;
    ismdata.out_x_a = acc_x;
    ismdata.out_y_a = acc_y;
    ismdata.out_z_a = acc_z;
    ismdata.outx_g = gyr_x;
    ismdata.outy_g = gyr_y;
    ismdata.outz_g = gyr_z;

    LOG_INF("\tTemperature: \t %d", temp);
    LOG_INF("\tAccelerometer: \t X:%d, \t Y:%d, \t Z:%d",acc_x,acc_y,acc_z);
    LOG_INF("\tGyroscope: \t X:%d, \t Y:%d, \t Z:%d",gyr_x,gyr_y,gyr_z);

    return 0;
}

/************ U Blox: ZED-F9P-02B ************/

// ***** from Christian *****

// reset the gps data
void gps_reset_data(struct gps_data *gps) {
	gps->time = 0;
	gps->longitude = 0;
	gps->latitude = 0;
	gps->horizontal_accuracy = 0;
	gps->sample_count = 0;
	gps->time_until_lock = 0;
}

//serial callback from uart rx interrupt, user_data contains the pointer to the gps struct
void gps_serial_cb(const struct device *dev, void *user_data) {
	uint8_t c;
	
	if (!uart_irq_update(gps_uart)) {
		return;
	}

	while (uart_irq_rx_ready(gps_uart)) {
		uart_fifo_read(gps_uart, &c, 1);

		if (gps_rx_buf_pos < (GPS_RX_BUF_SIZE - 1)) {
			gps_rx_uart_buffer[gps_rx_buf_pos++] = c;
		} else {
			gps_rx_buf_pos = 0;

			LOG_HEXDUMP_INF(gps_rx_uart_buffer, GPS_RX_BUF_SIZE, "rx_buf");
			gps_parse_rxbuffer(user_data, gps_rx_uart_buffer, GPS_RX_BUF_SIZE); //parse if buffer is full
		}
	}
}

//parsing recorded rx buffer and write to gps struct if valid data, needs pointer to buffer to read
void gps_parse_rxbuffer(struct gps_data *gps, char rx_buf[], int32_t buffer_len) {
	char ubx_nav_response[GPS_RX_BUF_SIZE];
	const char *next_ubx_msg_position;
	int32_t decoded_byte_count;
	int32_t decoded_messageid;
	int32_t decoded_classid;
	int32_t temp_horz_accuracy;
	int32_t k;
	
	//first message in the buffer, set pointer correctly
	next_ubx_msg_position = rx_buf;
	
	//decode the ubx protocol message. (ret positive if decoded with number of bytes of response) 
	for (k = 0; k < UBX_MAX_MSG_IN_BUFFER; k++) {        
		decoded_classid = 0;
		decoded_messageid = 0;  	
		decoded_byte_count = uUbxProtocolDecode(next_ubx_msg_position, buffer_len, &decoded_classid, &decoded_messageid, ubx_nav_response, GPS_RX_BUF_SIZE, &next_ubx_msg_position);

        // for debugging
        LOG_DBG("decoded byte count: %d, decoded_classid: %d, decoded_messageid: %d",decoded_byte_count,decoded_classid,decoded_messageid);
        //LOG_HEXDUMP_INF(ubx_nav_response, GPS_RX_BUF_SIZE, "ubx_nav_response");

		if (decoded_byte_count > 0) {
			//sane NAV_POSLLH response from module
			if (decoded_byte_count == 28 && decoded_classid == UBX_CLASS_NAV && decoded_messageid == UBX_MSGID_POSLLH) {
				gps->longitude = (ubx_nav_response[7] << 24) | (ubx_nav_response[6] << 16) | (ubx_nav_response[5] << 8) | (ubx_nav_response[4]);
				gps->latitude = (ubx_nav_response[11] << 24) | (ubx_nav_response[10] << 16) | (ubx_nav_response[9] << 8) | (ubx_nav_response[8]);
				gps->horizontal_accuracy = 0;
				temp_horz_accuracy = 0;
				temp_horz_accuracy = (ubx_nav_response[23] << 24) | (ubx_nav_response[22] << 16) | (ubx_nav_response[21] << 8) | (ubx_nav_response[20]);
				
				//change to meter and limit to reasonable values
				if (temp_horz_accuracy > 0) {
					temp_horz_accuracy /= 1000; //now unit meter
					if (temp_horz_accuracy > 0x7FFF) { 
						gps->horizontal_accuracy = 0x7FFF;
					} else {
						gps->horizontal_accuracy =  (int16_t)(temp_horz_accuracy);
					}
				} else {
					gps->horizontal_accuracy = (int16_t) temp_horz_accuracy;
				}

				//LOG_INF("got lon %i, lat %i", gps.longitude, gps.latitude);
				if ((gps->longitude != 0) && (gps->latitude != 0)) {
					gps->sample_count++;
				}
				
			}
			//sane NAV_TIMEUTC from module
			if (decoded_byte_count == 20 && decoded_classid == UBX_CLASS_NAV && decoded_messageid == UBX_MSGID_TIMEUTC) {
				gps->time = ubx_nav_response[16]*10000 + ubx_nav_response[17]*100 + ubx_nav_response[18];
			}
		} else {
			break; //nothing in this buffer
		}
	}
}
// ***** end of Christians part *******

void gps_init(){
    uint32_t bytes_written_to_buffer;

    // already the default values, uncomment and send if the module is no longer in default config.
    // uint8_t ubx_request[GPS_TX_BUF_SIZE] = {0x00,0x07,0x00,0x00, // first 4 bytes of message
    //                 0x40,0x52,0x00,0x01,0x00,0x00,0x96,0x00, // key and value for: bauderate of 38400
    //                 0x20,0x52,0x00,0x02,0x01, // key and value for: stop bits
    //                 0x20,0x52,0x00,0x03,0x00, // key and value for: 8 data bits
    //                 0x20,0x52,0x00,0x04,0x00, // key and value for: 0 parity bits
    //                 0x10,0x52,0x00,0x05,0x01, // key and value for: 
    //                 0x10,0x73,0x00,0x01,0x01, // key and value for: input UBX protocol
    //                 0x10,0x74,0x00,0x01,0x01}; // key and value for: output UBX protocol
    // char tx_buf[GPS_TX_BUF_SIZE];
    // bytes_written_to_buffer = uUbxProtocolEncode(UBX_CLASS_CFG, UBX_MSGID_VALSET, ubx_request, 42, tx_buf);
    // for(uint32_t poll_k = 0; poll_k < bytes_written_to_buffer; poll_k++) {
	// 	uart_poll_out(gps_uart,tx_buf[poll_k]);
	// }
    
    // payload for UBX_CFG_VALSET for CFG_MSGOUT:
    uint8_t ubx_request_poll[GPS_TX_BUF_SIZE] = 
                    {0x00,0x07,0x00,0x00, //save the configuration in all three layers of memory storage
                    0x2a,0x00,0x91,0x20,0x00, // key and value for: enable nav posllh at uart 1
                    0x5c,0x00,0x91,0x20,0x00, // key and value for: enable nav utc at uart 1
                    0xb1,0x00,0x91,0x20,0x00, // key and value for: disable nmea vtg at uart 1
                    0xac,0x00,0x91,0x20,0x00, // key and value for: disable nmea rmc at uart 1
                    0xc5,0x00,0x91,0x20,0x00, // key and value for: disable nmea gsv at uart 1
                    0xc0,0x00,0x91,0x20,0x00, // key and value for: disable nmea gsa at uart 1
                    0xca,0x00,0x91,0x20,0x00, // key and value for: disable nmea gll at uart 1
                    0xbb,0x00,0x91,0x20,0x00}; // key and value for: disable nmea gga at uart 1

	
    char tx_buf_poll[GPS_TX_BUF_SIZE];
    
    // encode the payload as a whole ubx message
    bytes_written_to_buffer = uUbxProtocolEncode(UBX_CLASS_CFG,UBX_MSGID_VALSET,ubx_request_poll,44,tx_buf_poll);
    // send message over uart
    for(uint32_t poll_k = 0; poll_k < 52; poll_k++) {
		uart_poll_out(gps_uart,tx_buf_poll[poll_k]);
	}
    // could possibly at a wait for UBX_ACK_ACK (length 2, Class 0x05, ID 0x01)
    return;
}

void gps_poll(struct gps_data *gps){
	char buf_tx[GPS_TX_BUF_SIZE];
	int32_t encoded_byte_count;
    
    // encode polling messages once, then use multiple times
	// naviation request message (we read the one of the last request, but only few seconds old so no issue)
	encoded_byte_count = uUbxProtocolEncode(UBX_CLASS_NAV, UBX_MSGID_POSLLH, NULL, 0, buf_tx);
	encoded_byte_count += 16;
	// time request message and append in buffer
	encoded_byte_count += uUbxProtocolEncode(UBX_CLASS_NAV, UBX_MSGID_TIMEUTC, NULL, 0, buf_tx+encoded_byte_count);

	k_sleep(K_SECONDS(1));

	// send polling requests via uart
	for(uint32_t poll_k = 0; poll_k < encoded_byte_count; poll_k++) {
		uart_poll_out(gps_uart, buf_tx[poll_k]);
	}
		
	//current state, if time stays 0 we do not get any serial messages...
	LOG_INF("lon; %i; lat; %i; time; %i; horAcc; %i", gps->longitude, gps->latitude, gps->time, gps->horizontal_accuracy);
				
	// track how long the locking takes. Currently not in use...
	gps->time_until_lock++;
 	

    // LOG_INF("lon; %i; lat; %i; time; %i; horAcc; %i", gps->longitude, gps->latitude, gps->time, gps->horizontal_accuracy);

    // Check if response from last time is in buffer
	//gps_parse_rxbuffer(gps, gps_rx_uart_buffer, GPS_RX_BUF_SIZE); 

    return;
}

/************ LED-Ring and Power manager: nPM1300-QEAA ************/
//not mine
void dev_not_ready_details(const struct device* dev) {
	if(dev == NULL) {
		LOG_ERR("dev is NULL\r\n");
		return;
	}
	if(!dev->state->initialized) {
		LOG_ERR("dev->state->initialized is false\r\n");
	}
	if(dev->state->init_res != 0) {
		LOG_ERR("errno %u\r\n", dev->state->init_res);
	}
	return;
}

//npm1300 init
int npm1300_led_colour_set(led_color_t colour){
    // turn off leds complitly
    int ret = led_off(npm_led,red);
    ret |= led_off(npm_led,green);
    ret |= led_off(npm_led,blue);

    switch (colour) {
        case (led_color_t) red:
            ret |= led_on(npm_led,red);
            break;
        case (led_color_t) green:
            ret |= led_on(npm_led,green);
            break;
        case (led_color_t) blue:
            ret |= led_on(npm_led,blue);
            break;
        case (led_color_t) yellow:
            ret |= led_on(npm_led,red);
            ret |= led_on(npm_led,green);
            break;
        case (led_color_t) magenta:
            ret |= led_on(npm_led,red);
            ret |= led_on(npm_led,blue);
            break;
        case (led_color_t) cyan:
            ret |= led_on(npm_led,green);
            ret |= led_on(npm_led,blue);
            break;
        case (led_color_t) white:
            ret |= led_on(npm_led,red);
            ret |= led_on(npm_led,green);
            ret |= led_on(npm_led,blue);
            break;
        default: //no valid colour
            LOG_ERR("Colour: %u is not valid",colour);
            ret = -1;
            break;
    }
    return ret;
}

int npm1300_init() {
    int err = 0;
    if (!device_is_ready(npm1300)){
        LOG_ERR("npm1300 not read");
        dev_not_ready_details(npm1300);
        return -1;
    }
    if (!device_is_ready(regulator)){
        LOG_ERR("regulator device not ready");
        dev_not_ready_details(regulator);
        err = -1;
    }
    if (!device_is_ready(charger)){
        LOG_ERR("charger device not ready");
        dev_not_ready_details(charger);
        err = -1;
    }
    if (!device_is_ready(npm_led)){
        LOG_ERR("npm LEDs device not ready");
        dev_not_ready_details(npm1300);
        err = -1;
    }
    // turn on based on MASTER or SLAVE (master == magenta, slave == yellow)
#if MASTER
    npm1300_led_colour_set(magenta);
#else
    npm1300_led_colour_set(yellow);
#endif
    return err;
}

//lp5012 init
int lp5012_init(){
    if(!device_is_ready(lp5012_dev)){
        LOG_ERR("LED controller %s is not ready",lp5012_dev->name);
        dev_not_ready_details(lp5012_dev);
        return -1;
    }
    int err;
    uint8_t buff[3] = {0xFF,0x00,0xFF};

    for(int l = 0; l < 3; l++){
        err = led_set_color(lp5012_dev,0,3,buff);
        if(err<0){
            LOG_ERR("Failed");
        }
    }
}

//when received an interrupt: red blinking 3times

//point to slave if possible


/************ LoRa ************/

//lora init
int is_lora_busy(){
    const struct gpio_dt_spec busy = GPIO_DT_SPEC_GET(DT_CHILD(DT_NODELABEL(spi1),loradev_0),busy_gpios);
    int by = gpio_pin_get_dt(&busy);
    LOG_INF("Busy = %d",by);
    return by;
}


int lora_init(){
    if (!device_is_ready(lora_dev)){
        LOG_ERR("lora not ready"); // try resetting and try again if still not return -1

        const struct gpio_dt_spec reset = GPIO_DT_SPEC_GET(DT_CHILD(DT_NODELABEL(spi1),loradev_0),reset_gpios);
        gpio_pin_configure_dt(&reset, GPIO_OUTPUT_ACTIVE);
        k_msleep(100); //at least 1ms
        gpio_pin_configure_dt(&reset, GPIO_OUTPUT_INACTIVE);
        k_msleep(100);

        if(!device_is_ready(lora_dev)){
            LOG_ERR("Reset did not work, lora still not ready");
            return -1;
        }
    }

    struct lora_modem_config lora_con = {
        .frequency = 865100000, //863MHz - 870MHz
        .bandwidth = BW_125_KHZ, // shouldn't use 500kHz
        .datarate = SF_7,
        .coding_rate = CR_4_5,
        .preamble_len = 8, // as short as possible for reduced latency
        .iq_inverted = false,
        .public_network = false,
        .tx_power = 4,
#if MASTER
        .tx = false
#else
        .tx = true
#endif
    };

    int err = lora_config(lora_dev,&lora_con);
    if (err < 0){
        LOG_ERR("configuration LoRa failed!");
        return err;
    }
    LOG_DBG("LoRa initialized");
    return 0;
}

//lora send
int lora_send_data(struct gps_data *gps){
    gps_poll(gps);

    struct lora_payload payload = {
        .preamble = LORA_PREAMBLE,
        .origin_device_id = (uint64_t)UNIQUE_CHIP_ID,
        .latitude = gps->latitude,
        .longitude = gps->longitude,
        .horizontal_accuracy = gps->horizontal_accuracy,
        .time = gps->time
    };

    k_msleep(1000);

    int err = lora_send(lora_dev,(uint8_t*)(&payload),sizeof(payload));

    if(err < 0){
        LOG_ERR("LoRa send failed!, size: %d",sizeof(payload));
        return err;
    }

    LOG_INF("sent user data over LoRa of size: %d", sizeof(payload));
    return 0;
}

//lora receive_data
int lora_receive_data(struct gps_data *gps_slave,uint64_t *origin, int16_t *rssi, int8_t *snr){
    struct lora_payload payload;
    
    LOG_DBG("before receiving");
    int len = lora_recv(lora_dev, (uint8_t*)(&payload), sizeof(payload), K_FOREVER, rssi, snr);
    LOG_DBG("after receiving");

    if(len < 0){
        LOG_ERR("LoRa receive failed with err: %d",len);
        return len;
    }

    LOG_INF("Received data with length of %d",len);

    LOG_DBG("preamble: \t %d \t origin_device_id \t 0x%016llx",payload.preamble,payload.origin_device_id);

    // only update if same preamble -> was ment for us
    if(payload.preamble == LORA_PREAMBLE){
        LOG_INF("Updating gps values");
        gps_slave->longitude=payload.longitude;
        gps_slave->latitude=payload.longitude;
        gps_slave->horizontal_accuracy=payload.horizontal_accuracy;
        gps_slave->time=payload.time;
        *origin = payload.origin_device_id;
        LOG_INF("lon; %i; lat; %i; time; %i; horAcc; %i", gps_slave->longitude, gps_slave->latitude, gps_slave->time, gps_slave->horizontal_accuracy);
        return 0;
    }
    return -1;
}

int lora_wakeup(){
    const struct gpio_dt_spec cs = GPIO_DT_SPEC_GET(DT_NODELABEL(spi1), cs_gpios);
    int err = gpio_pin_configure_dt(&cs, GPIO_OUTPUT_ACTIVE);
    if(err != 0){
        LOG_ERR("could not set cs low, could not wake lora up");
        return err;
    }
    return 0;
}
```

## src/functionalities.h
```c
#include "project.h"

#ifndef FUNCTIONALITIES_H
#define FUNCTIONALITIES_H

#define MAIN_THREAD_STACK_SIZE 4096
#define MAIN_THREAD_PRIORITY 5

/************ sensor: LSM303AHTR ************/
// configuration values TODO:change
#define CTRL1_A         0xF0
#define CTRL2_A         0x07
#define CFG_REG_A_M     0x01
#define CFG_REG_B_M     0x04
#define CFG_REG_C_M     0x20

#define DELAY_PARAM     500 //TODO
#define DELAY_REG       100 //TODO

#define SPIOP	SPI_WORD_SET(8) | SPI_TRANSFER_MSB
static struct spi_dt_spec lsm303_spispec = SPI_DT_SPEC_GET(DT_NODELABEL(lsm303agr), SPIOP, 0);

struct lsm_config { // struct to store the sensor configurations
        uint8_t ctrl1_A;
        uint8_t ctrl2_A;
        uint8_t cfg_reg_a_m;
        uint8_t cfg_reg_b_m;
        uint8_t cfg_reg_c_m;
};

struct lsm_data {
        int8_t out_t_a;
        int16_t out_x_a;
        int16_t out_y_a;
        int16_t out_z_a;
        int16_t outx_m;
        int16_t outy_m;
        int16_t outz_m;
};

static int lsm_read_reg(uint8_t reg, uint8_t *data, uint8_t size);
static int lsm_write_reg(uint8_t reg, uint8_t value);
void lsm_init(void);
int lsm_read_outputs(struct lsm_data lsmdata);

/************ sensor: ISM330DHCXTR ************/
// configuration values TODO:change
#define CTRL1_XL        0x40
#define CTRL2_G         0x50

#define DELAY_PARAM_ISM     500 //TODO
#define DELAY_REG_ISM       100 //TODO

#define SPIOP	SPI_WORD_SET(8) | SPI_TRANSFER_MSB
static struct spi_dt_spec ism330_spispec = SPI_DT_SPEC_GET(DT_NODELABEL(ism330dhcx), SPIOP, 0);

struct ism_config { // struct to store the sensor configurations
        uint8_t ctrl1_XL;
        uint8_t ctrl2_G;
};

struct ism_data {
        int16_t out_temp;
        int16_t out_x_a;
        int16_t out_y_a;
        int16_t out_z_a;
        int16_t outx_g;
        int16_t outy_g;
        int16_t outz_g;
};

static int ism_read_reg(uint8_t reg, uint8_t *data, uint8_t size);
static int ism_write_reg(uint8_t reg, uint8_t value);
void ism_init(void);
int ism_read_outputs(struct ism_data ismdata);

/************ U Blox: ZED-F9P-02B ************/
// copy from christian:

#define GPS_RX_BUF_SIZE 128
#define GPS_TX_BUF_SIZE 64
#define UBX_MAX_MSG_IN_BUFFER 3
#define UBX_CLASS_NAV 0x01
#define UBX_MSGID_POSLLH 0x02
#define UBX_MSGID_TIMEUTC 0x21
#define UBX_CLASS_CFG 0x06
#define UBX_MSGID_VALSET 0x8a

static struct device *gps_uart = DEVICE_DT_GET(DT_NODELABEL(uart0));

// use only one buffer
static char gps_rx_uart_buffer[GPS_RX_BUF_SIZE];
static int gps_rx_buf_pos;

// TODO: change attributes
struct gps_data {
   int32_t latitude;
   int32_t longitude;
   int32_t time;
   int16_t horizontal_accuracy;
   uint16_t time_until_lock;
   int32_t sample_count;
};	

void gps_reset_data(struct gps_data *gps);
void gps_serial_cb(const struct device *dev, void *user_data);
void gps_parse_rxbuffer(struct gps_data *gps, char rx_buf[], int32_t buffer_len);
void gps_initialize_module();
void gps_init();
void gps_poll(struct gps_data *gps);

/************ LED-Ring and Power manager: nPM1300-QEAA ************/
typedef enum {
    red = 0u,               // channel 0
    blue,                   // channel 1
    green,                  // channel 2
    yellow,                 // red and green
    magenta,                // red and blue
    cyan,                   // green and blue
    white,                  // red, green and blue
    n_elements_led_color    // not a valid color
} led_color_t;

static const struct device *regulator = DEVICE_DT_GET(DT_NODELABEL(npm1300_ek_regulators));
static const struct device *charger = DEVICE_DT_GET(DT_NODELABEL(npm1300_ek_charger));
static const struct device *npm_led = DEVICE_DT_GET(DT_NODELABEL(npm1300_ek_leds));
static const struct device *npm_gpios = DEVICE_DT_GET(DT_NODELABEL(npm1300_ek_gpio));
static const struct device *npm1300 = DEVICE_DT_GET(DT_NODELABEL(npm1300));

static const struct device *lp5012_dev = DEVICE_DT_GET_ANY(ti_lp5012);

void dev_not_ready_details(const struct device* dev);
int npm1300_led_colour_set(led_color_t colour);
int npm1300_init();
int lp5012_init();

/************ LoRa ************/
#define LORA_PREAMBLE   0b1010110011110000 //2 bytes / 8 bit

// TODO: add information on interrupt
struct lora_payload {
        uint16_t preamble;
        uint64_t origin_device_id;
        int32_t latitude;
        int32_t longitude;
        int32_t time;
        int16_t horizontal_accuracy;
};



static const struct device* lora_dev = DEVICE_DT_GET(DT_NODELABEL(lora_dev));

int is_lora_busy();
int lora_init();
int lora_send_data(struct gps_data *gps);
int lora_receive_data(struct gps_data *gps_slave,uint64_t *origin, int16_t *rssi, int8_t *snr);
int lora_wakeup();

#endif
```

## src/project.h
```c
#include <zephyr/kernel.h>
#include <zephyr/device.h>
#include <zephyr/devicetree.h>
#include <zephyr/drivers/gpio.h>
#include <zephyr/drivers/uart.h>
#include <zephyr/drivers/spi.h>
#include <zephyr/drivers/lora.h>
#include <zephyr/drivers/sensor.h>
#include <zephyr/drivers/led.h>
#include <zephyr/drivers/led/lp50xx.h>
#include <zephyr/drivers/sensor/npm1300_charger.h>
#include <zephyr/drivers/regulator.h>
#include <zephyr/drivers/mfd/npm1300.h>
#include <zephyr/logging/log.h>
#include "u_ubx_protocol.h"

#ifndef PROJECT_H
#define PROJECT_H

#define MASTER 0

/**
 * @brief 64 bit "unique" (random) identifier of the nRF52832
*/
#define UNIQUE_CHIP_ID ((((uint64_t)NRF_FICR->DEVICEADDR[1]) << 32) | ((uint64_t)NRF_FICR->DEVICEADDR[0]))

#endif
```

## src/u_ubx_protocol.c
```c
/*
 * Copyright 2019-2024 u-blox
 *
 * Licensed under the Apache License, Version 2.0 (the "License");
 * you may not use this file except in compliance with the License.
 * You may obtain a copy of the License at
 *
 * http://www.apache.org/licenses/LICENSE-2.0
 *
 * Unless required by applicable law or agreed to in writing, software
 * distributed under the License is distributed on an "AS IS" BASIS,
 * WITHOUT WARRANTIES OR CONDITIONS OF ANY KIND, either express or implied.
 * See the License for the specific language governing permissions and
 * limitations under the License.
 */

/* Only #includes of u_* and the C standard library are allowed here,
 * no platform stuff and no OS stuff.  Anything required from
 * the platform/OS must be brought in through u_port* to maintain
 * portability.
 */

/** @file
 * @brief Implementation of the UBX protocol message encode/decode API.
 */

#ifdef U_CFG_OVERRIDE
# include "u_cfg_override.h" // For a customer's configuration override
#endif

#include "stddef.h"    // NULL, size_t etc.
#include "stdint.h"    // int32_t etc.
#include "stdbool.h"
#include "string.h"    // memcpy()

#include "u_error_common.h"

#include "u_ubx_protocol.h"

/* ----------------------------------------------------------------
 * COMPILE-TIME MACROS
 * -------------------------------------------------------------- */

/* ----------------------------------------------------------------
 * TYPES
 * -------------------------------------------------------------- */

/* ----------------------------------------------------------------
 * VARIABLES
 * -------------------------------------------------------------- */

/* ----------------------------------------------------------------
 * STATIC FUNCTIONS
 * -------------------------------------------------------------- */

/* ----------------------------------------------------------------
 * PUBLIC FUNCTIONS
 * -------------------------------------------------------------- */

// Wot it says it does.
bool uUbxProtocolIsLittleEndian()
{
    int32_t x = 1;

    return (*((char *) (&x)) == 1);
}

// Return a uint16_t from a pointer to a little-endian uint16_t.
uint16_t uUbxProtocolUint16Decode(const char *pByte)
{
    // Use a uint8_t pointer for maths, more certain of its behaviour than char
    const uint8_t *pInput = (const uint8_t *) pByte;
    uint16_t retValue;

    retValue  = *pInput;
    // Cast twice to keep Lint happy
    retValue += (uint16_t) (((uint16_t) *(pInput + 1)) << 8); // *NOPAD*

    return  retValue;
}

// Return a uint32_t from a pointer to a little-endian uint32_t.
uint32_t uUbxProtocolUint32Decode(const char *pByte)
{
    // Use a uint8_t pointer for maths, more certain of its behaviour than char
    const uint8_t *pInput = (const uint8_t *) pByte;
    uint32_t retValue;

    retValue  = *pInput;
    // Cast twice to keep Lint happy
    retValue += ((uint32_t) *(pInput + 1)) << 8;  // *NOPAD*
    retValue += ((uint32_t) *(pInput + 2)) << 16; // *NOPAD*
    retValue += ((uint32_t) *(pInput + 3)) << 24; // *NOPAD*

    return retValue;
}

// Return a uint64_t from a pointer to a little-endian uint64_t.
uint64_t uUbxProtocolUint64Decode(const char *pByte)
{
    // Use a uint8_t pointer for maths, more certain of its behaviour than char
    const uint8_t *pInput = (const uint8_t *) pByte;
    uint64_t retValue;

    retValue  = *pInput;
    // Cast twice to keep Lint happy
    retValue += ((uint64_t) *(pInput + 1)) << 8;  // *NOPAD*
    retValue += ((uint64_t) *(pInput + 2)) << 16; // *NOPAD*
    retValue += ((uint64_t) *(pInput + 3)) << 24; // *NOPAD*
    retValue += ((uint64_t) *(pInput + 4)) << 32; // *NOPAD*
    retValue += ((uint64_t) *(pInput + 5)) << 40; // *NOPAD*
    retValue += ((uint64_t) *(pInput + 6)) << 48; // *NOPAD*
    retValue += ((uint64_t) *(pInput + 7)) << 56; // *NOPAD*

    return retValue;
}

// Return a little-endian uint16_t from the given uint16_t.
uint16_t uUbxProtocolUint16Encode(uint16_t uint16)
{
    uint16_t retValue = uint16;

    if (!uUbxProtocolIsLittleEndian()) {
        retValue  = (uint16 & 0xFF00) >> 8;
        retValue += (uint16 & 0x00FF) << 8;
    }

    return retValue;
}

// Return a little-endian uint32_t from the given uint32_t.
uint32_t uUbxProtocolUint32Encode(uint32_t uint32)
{
    uint32_t retValue = uint32;

    if (!uUbxProtocolIsLittleEndian()) {
        retValue  = (uint32 & 0xFF000000) >> 24;
        retValue += (uint32 & 0x00FF0000) >> 8;
        retValue += (uint32 & 0x0000FF00) << 8;
        retValue += (uint32 & 0x000000FF) << 24;
    }

    return  retValue;
}

// Return a little-endian uint64_t from the given uint64_t.
uint64_t uUbxProtocolUint64Encode(uint64_t uint64)
{
    uint64_t retValue = uint64;

    if (!uUbxProtocolIsLittleEndian()) {
        retValue  = (uint64 & 0xFF00000000000000) >> 56;
        retValue += (uint64 & 0x00FF000000000000) >> 40;
        retValue += (uint64 & 0x0000FF0000000000) >> 24;
        retValue += (uint64 & 0x000000FF00000000) >> 8;
        retValue += (uint64 & 0x00000000FF000000) << 8;
        retValue += (uint64 & 0x0000000000FF0000) << 24;
        retValue += (uint64 & 0x000000000000FF00) << 40;
        retValue += (uint64 & 0x00000000000000FF) << 56;
    }

    return  retValue;
}

// Encode a UBX protocol message.
int32_t uUbxProtocolEncode(int32_t messageClass, int32_t messageId,
                           const char *pMessage, size_t messageBodyLengthBytes,
                           char *pBuffer)
{
    int32_t errorCodeOrLength = (int32_t) U_ERROR_COMMON_INVALID_PARAMETER;
    // Use a uint8_t pointer for maths, more certain of its behaviour than char
    uint8_t *pWrite = (uint8_t *) pBuffer;
    int32_t ca = 0;
    int32_t cb = 0;

    if (((messageBodyLengthBytes == 0) || (pMessage != NULL)) &&
        (pBuffer != NULL)) {

        // Complete the header
        *pWrite++ = 0xb5;
        *pWrite++ = 0x62;
        *pWrite++ = (uint8_t) messageClass;
        *pWrite++ = (uint8_t) messageId;
        *pWrite++ = (uint8_t) (messageBodyLengthBytes & (uint8_t) 0xff);
        *pWrite++ = (uint8_t) (messageBodyLengthBytes >> 8);

        if (pMessage != NULL) {
            // Copy in the message body
            memcpy(pWrite, pMessage, messageBodyLengthBytes);
            pWrite += messageBodyLengthBytes;
        }

        // Work out the CRC over the variable elements of the
        // header and the body
        pBuffer += 2;
        for (size_t x = 0; x < messageBodyLengthBytes + 4; x++) {
            ca += (uint8_t) *pBuffer; // *NOPAD*
            cb += ca;
            pBuffer++;
        }

        // Write in the CRC
        *pWrite++ = (uint8_t) (ca & (uint8_t) 0xff);
        *pWrite = (uint8_t) (cb & (uint8_t) 0xff);

        errorCodeOrLength = (int32_t) (U_UBX_PROTOCOL_OVERHEAD_LENGTH_BYTES + messageBodyLengthBytes);
    }

    return errorCodeOrLength;
}

// Decode a UBX protocol message.
int32_t uUbxProtocolDecode(const char *pBufferIn, size_t bufferLengthBytes,
                           int32_t *pMessageClass, int32_t *pMessageId,
                           char *pMessage, size_t maxMessageLengthBytes,
                           const char **ppBufferOut)
{
    int32_t sizeOrErrorCode = (int32_t) U_ERROR_COMMON_NOT_FOUND;
    // Use a uint8_t pointer for maths, more certain of its behaviour than char
    const uint8_t *pInput = (const uint8_t *) pBufferIn;
    int32_t overheadByteCount = 0;
    bool updateCrc = false;
    size_t expectedMessageByteCount = 0;
    size_t messageByteCount = 0;
    int32_t ca = 0;
    int32_t cb = 0;

    for (size_t x = 0; (x < bufferLengthBytes) &&
         (overheadByteCount < U_UBX_PROTOCOL_OVERHEAD_LENGTH_BYTES); x++) {
        switch (overheadByteCount) {
            case 0:
                //lint -e{650} Suppress warning about 0xb5 being out of range for char
                if (*pInput == 0xb5) {
                    // Got first byte of header, increment count
                    overheadByteCount++;
                }
                break;
            case 1:
                if (*pInput == 0x62) {
                    // Got second byte of header, increment count
                    overheadByteCount++;
                } else {
                    // Not a valid message, start again
                    overheadByteCount = 0;
                }
                break;
            case 2:
                // Got message class, store it, start CRC
                // calculation and increment count
                if (pMessageClass != NULL) {
                    *pMessageClass = *pInput;
                }
                ca = 0;
                cb = 0;
                updateCrc = true;
                overheadByteCount++;
                break;
            case 3:
                // Got message ID, store it, update CRC and
                // increment count
                if (pMessageId != NULL) {
                    *pMessageId = *pInput;
                }
                updateCrc = true;
                overheadByteCount++;
                break;
            case 4:
                // Got first byte of length, store it, update
                // CRC and increment count
                expectedMessageByteCount = *pInput;
                updateCrc = true;
                overheadByteCount++;
                break;
            case 5:
                // Got second byte of length, add it to the first,
                // updat CRC, increment count and reset the
                // message byte count ready for the body to come next.
                // Cast twice to keep Lint happy
                expectedMessageByteCount += ((size_t) *pInput) << 8; // *NOPAD*
                messageByteCount = 0;
                updateCrc = true;
                overheadByteCount++;
                break;
            case 6:
                if (messageByteCount < expectedMessageByteCount) {
                    // Store the next byte of the message and
                    // update CRC
                    if ((pMessage != NULL) && (messageByteCount < maxMessageLengthBytes)) {
                        *pMessage++ = (char) *pInput; // *NOPAD*
                    }
                    updateCrc = true;
                    messageByteCount++;
                } else {
                    // First byte of CRC, check it
                    ca &= 0xff;
                    if ((uint8_t) ca == *pInput) {
                        overheadByteCount++;
                    } else {
                        // Not a valid message, start again
                        overheadByteCount = 0;
                    }
                }
                break;
            case 7:
                // Second byte of CRC, check it
                cb &= 0xff;
                if ((uint8_t) cb == *pInput) {
                    overheadByteCount++;
                } else {
                    // Not a valid message, start again
                    overheadByteCount = 0;
                }
                break;
            default:
                overheadByteCount = 0;
                break;
        }

        if (updateCrc) {
            ca += *pInput;
            cb += ca;
            updateCrc = false;
        }

        // Next byte
        pInput++;
    }

    if (overheadByteCount > 0) {
        // We got some parts of the message overhead, so
        // could be a message
        sizeOrErrorCode = (int32_t) U_ERROR_COMMON_TIMEOUT;
        if (overheadByteCount == U_UBX_PROTOCOL_OVERHEAD_LENGTH_BYTES) {
            // We got all the overhead bytes, this is a complete message
            sizeOrErrorCode = (int32_t) messageByteCount;
        }
    }

    if (ppBufferOut != NULL) {
        *ppBufferOut =  (const char *) pInput;
    }

    return sizeOrErrorCode;
}

// End of file
```
